## CMakeLists.txt
```
cmake_minimum_required(VERSION 3.20.0)
find_package(Zephyr REQUIRED HINTS $ENV{ZEPHYR_BASE})
project(uno_q_hat)
target_sources(app PRIVATE src/main.c src/protocol.c src/animation.c)
# Identify the application sources/configuration used for this firmware.
set(fingerprint "")
foreach(input src/main.c src/protocol.c src/protocol.h src/animation.c src/animation.h prj.conf app.overlay)
  set_property(DIRECTORY APPEND PROPERTY CMAKE_CONFIGURE_DEPENDS "${input}")
  file(SHA256 "${CMAKE_CURRENT_SOURCE_DIR}/${input}" digest)
  string(APPEND fingerprint "${digest}")
endforeach()
string(SHA256 fingerprint "${fingerprint}")
string(SUBSTRING "${fingerprint}" 0 12 firmware_version)
target_compile_definitions(app PRIVATE HAT_FIRMWARE_VERSION="${firmware_version}")
```

## prj.conf
```kconfig
CONFIG_DISPLAY=y
CONFIG_COUNTER=y
CONFIG_BOOTLOADER_MCUBOOT=n
CONFIG_FLASH_LOAD_OFFSET=0
CONFIG_CONSOLE=n
CONFIG_UART_CONSOLE=n
CONFIG_SERIAL=n
CONFIG_MAIN_STACK_SIZE=1024
```

## src/main.c
```c
/* SPDX-License-Identifier: Apache-2.0 */
#include <zephyr/device.h>
#include <zephyr/drivers/display.h>
#include <zephyr/drivers/uart.h>
#include <zephyr/kernel.h>
#include <zephyr/random/random.h>
#include <zephyr/sys/atomic.h>
#include <zephyr/sys/ring_buffer.h>
#include <inttypes.h>
#include <stdio.h>
#include <string.h>
#include "protocol.h"
#include "animation.h"

static const char hat[8][14] = {
    ".............", "....##.##....", "...#######...", "...#######...",
    "...###.###...", ".#####.#####.", "#############", "..#########..",
};
static const struct device *const display =
    DEVICE_DT_GET(DT_CHOSEN(zephyr_display));
static const struct device *const uart = DEVICE_DT_GET(DT_NODELABEL(lpuart1));
RING_BUF_DECLARE(rx, 256);
K_SEM_DEFINE(rx_ready, 0, 1);
static atomic_t overflow;
static uint32_t boot_id;
static struct hat_player player;
static uint8_t last_frame[HAT_FRAME_SIZE];

static void receive(const struct device *dev, void *context)
{
	ARG_UNUSED(context);
	uart_irq_update(dev);
	while (uart_irq_rx_ready(dev)) {
		uint8_t bytes[16];
		int n = uart_fifo_read(dev, bytes, sizeof(bytes));
		if (n <= 0)
			break;
		if (ring_buf_put(&rx, bytes, n) != (uint32_t)n) {
			atomic_set(&overflow, 1);
			uart_irq_rx_disable(dev);
			break;
		}
	}
	k_sem_give(&rx_ready);
}

static int write_frame(const uint8_t *pixels)
{
	const struct display_buffer_descriptor desc = {
	    .buf_size = HAT_FRAME_SIZE,
	    .width = 13,
	    .height = 8,
	    .pitch = 16,
	};
	int rc = display_write(display, 0, 0, &desc, pixels);
	if (!rc)
		memcpy(last_frame, pixels, sizeof(last_frame));
	return rc;
}

static int show_hat(void)
{
	uint8_t pixels[HAT_FRAME_SIZE] = {0};
	for (unsigned y = 0; y < 8; ++y)
		for (unsigned x = 0; x < 13; ++x)
			if (hat[y][x] == '#')
				pixels[y * 2 + x / 8] |= BIT(x % 8);
	return write_frame(pixels);
}

static int execute(const struct hat_command *cmd, char *result, size_t size,
		   void *context)
{
	ARG_UNUSED(context);
	switch (cmd->operation) {
	case HAT_HELLO:
		snprintf(result, size,
			 "proto=1 firmware=" HAT_FIRMWARE_VERSION
			 " width=13 height=8 anim=64 boot=%08" PRIx32,
			 boot_id);
		return 0;
	case HAT_PING:
		snprintf(result, size, "boot=%08" PRIx32 " uptime_ms=%" PRId64,
			 boot_id, k_uptime_get());
		return 0;
	case HAT_SHOW:
	case HAT_FRAME: {
		int rc = cmd->operation == HAT_SHOW ? show_hat()
						    : write_frame(cmd->pixels);
		if (!rc) {
			player.running = false;
			player.uploading = false;
		}
		return rc;
	}
	case HAT_ANIM_BEGIN:
	case HAT_ANIM_ADD:
	case HAT_ANIM_PLAY:
	case HAT_ANIM_STOP: {
		int rc = hat_player_command(&player, cmd, k_uptime_get(),
					    write_frame);
		if (!rc && cmd->operation == HAT_ANIM_STOP) {
			snprintf(result, size, "frame=");
			for (size_t i = 0; i < HAT_FRAME_SIZE; ++i)
				snprintf(result + 6 + i * 2, size - 6 - i * 2,
					 "%02x", last_frame[i]);
		}
		return rc;
	}
	case HAT_DISPLAY:
		return cmd->visible ? display_blanking_off(display)
				    : display_blanking_on(display);
	}
	return -EINVAL;
}

int main(void)
{
	if (!device_is_ready(display) || !device_is_ready(uart))
		return -ENODEV;
	int err = show_hat();
	if (!err)
		err = display_blanking_off(display);
	if (err)
		return err;
	boot_id = sys_rand32_get();
	err = uart_irq_callback_user_data_set(uart, receive, NULL);
	if (err)
		return err;
	uart_irq_rx_enable(uart);
	struct hat_parser parser = {0};
	char reply[HAT_LINE_MAX + 1];
	for (;;) {
		int64_t now = k_uptime_get();
		hat_player_tick(&player, now, write_frame);
		k_timeout_t timeout =
		    player.running
			? K_MSEC(MAX(0, player.deadline - k_uptime_get()))
			: K_FOREVER;
		k_sem_take(&rx_ready, timeout);
		uint8_t c;
		for (;;) {
			hat_player_tick(&player, k_uptime_get(), write_frame);
			unsigned key = irq_lock();
			if (atomic_set(&overflow, 0)) {
				ring_buf_reset(&rx);
				hat_resync(&parser);
				uart_irq_rx_enable(uart);
			}
			uint32_t n = ring_buf_get(&rx, &c, 1);
			irq_unlock(key);
			if (!n)
				break;
			if (hat_feed(&parser, c, reply, sizeof(reply), execute,
				     NULL))
				for (const char *s = reply; *s; ++s)
					uart_poll_out(uart, *s);
		}
	}
}
```

## src/animation.c
```c
/* SPDX-License-Identifier: Apache-2.0 */
#include "animation.h"
#include <errno.h>
#include <string.h>

int hat_player_command(struct hat_player *p, const struct hat_command *cmd,
		       int64_t now, hat_draw draw)
{
	switch (cmd->operation) {
	case HAT_ANIM_BEGIN:
		if (!cmd->value || cmd->value > HAT_ANIM_MAX)
			return -EINVAL;
		p->expected = cmd->value;
		p->uploaded = 0;
		p->uploading = true;
		return 0;
	case HAT_ANIM_ADD: {
		if (!p->uploading || p->uploaded == p->expected)
			return -EINVAL;
		struct hat_step *step = &p->banks[p->active ^ 1][p->uploaded++];
		step->duration_ms = cmd->value;
		memcpy(step->pixels, cmd->pixels, HAT_FRAME_SIZE);
		return 0;
	}
	case HAT_ANIM_PLAY: {
		if (!p->uploading || p->uploaded != p->expected)
			return -EINVAL;
		struct hat_step *first = &p->banks[p->active ^ 1][0];
		int rc = draw(first->pixels);
		if (rc)
			return rc;
		p->active ^= 1;
		p->count = p->expected;
		p->index = 0;
		p->remaining = cmd->value;
		p->deadline = now + first->duration_ms;
		p->running = true;
		p->uploading = false;
		return 0;
	}
	case HAT_ANIM_STOP:
		p->running = false;
		p->uploading = false;
		return 0;
	default:
		return -EINVAL;
	}
}

int hat_player_tick(struct hat_player *p, int64_t now, hat_draw draw)
{
	if (!p->running || now < p->deadline)
		return 0;
	size_t next = p->index + 1;
	if (next == p->count) {
		if (p->remaining == 1) {
			p->running = false;
			return 0;
		}
		if (p->remaining)
			--p->remaining;
		next = 0;
	}
	struct hat_step *step = &p->banks[p->active][next];
	int rc = draw(step->pixels);
	if (rc) {
		p->running = false;
		return rc;
	}
	p->index = next;
	/* Never burst through frames after a delayed wakeup. */
	p->deadline = now + step->duration_ms;
	return 0;
}
```

## src/protocol.c
```c
/* SPDX-License-Identifier: Apache-2.0 */
#include "protocol.h"
#include <inttypes.h>
#include <stdio.h>
#include <string.h>

static int hex(unsigned char c)
{
	if (c >= '0' && c <= '9')
		return c - '0';
	if (c >= 'a' && c <= 'f')
		return c - 'a' + 10;
	if (c >= 'A' && c <= 'F')
		return c - 'A' + 10;
	return -1;
}

const char *hat_parse_command(const char *s, struct hat_command *cmd)
{
	memset(cmd, 0, sizeof(*cmd));
	if (!strcmp(s, "HELLO"))
		cmd->operation = HAT_HELLO;
	else if (!strcmp(s, "PING"))
		cmd->operation = HAT_PING;
	else if (!strcmp(s, "SHOW HAT"))
		cmd->operation = HAT_SHOW;
	else if (!strcmp(s, "DISPLAY ON") || !strcmp(s, "DISPLAY OFF")) {
		cmd->operation = HAT_DISPLAY;
		cmd->visible = !strcmp(s, "DISPLAY ON");
	} else if (!strncmp(s, "FRAME ", 6)) {
		cmd->operation = HAT_FRAME;
		if (strlen(s + 6) != HAT_FRAME_SIZE * 2)
			return "BAD_ARGUMENT";
		for (size_t i = 0; i < HAT_FRAME_SIZE; ++i) {
			int high = hex(s[6 + i * 2]), low = hex(s[7 + i * 2]);
			if (high < 0 || low < 0)
				return "BAD_ARGUMENT";
			cmd->pixels[i] = (uint8_t)((high << 4) | low);
			if ((i & 1) && (cmd->pixels[i] & 0xe0))
				return "BAD_ARGUMENT";
		}
	} else {
		/* Known verbs with missing/extra arguments are distinguishable.
		 */
		static const char *const verbs[] = {"HELLO", "PING", "SHOW",
						    "DISPLAY", "FRAME"};
		for (size_t i = 0; i < sizeof(verbs) / sizeof(verbs[0]); ++i) {
			size_t n = strlen(verbs[i]);
			if (!strncmp(s, verbs[i], n) &&
			    (s[n] == 0 || s[n] == ' '))
				return "BAD_ARGUMENT";
		}
		return "UNKNOWN_COMMAND";
	}
	return NULL;
}

void hat_resync(struct hat_parser *p)
{
	p->used = 0;
	p->discard = true;
}

bool hat_feed(struct hat_parser *p, unsigned char c, char *reply, size_t size,
	      hat_handler handler, void *context)
{
	if (c != '\n') {
		if (!p->discard) {
			if (p->used == HAT_LINE_MAX ||
			    (c != '\r' && (c < 32 || c > 126)))
				hat_resync(p);
			else
				p->line[p->used++] = (char)c;
		}
		return false;
	}
	uint32_t id = 0;
	const char *error = NULL;
	char result[96] = "";
	if (p->discard)
		error = "BAD_LINE";
	else {
		if (p->used && p->line[p->used - 1] == '\r')
			--p->used;
		p->line[p->used] = 0;
		const char *s = p->line;
		if (*s < '1' || *s > '9')
			error = "BAD_ID";
		while (!error && *s >= '0' && *s <= '9') {
			unsigned digit = (unsigned)(*s++ - '0');
			if (id > (UINT32_MAX - digit) / 10)
				error = "BAD_ID";
			else
				id = id * 10 + digit;
		}
		if (error || *s != ' ') {
			id = 0;
			error = "BAD_ID";
		} else {
			struct hat_command cmd;
			error = hat_parse_command(s + 1, &cmd);
			if (!error &&
			    handler(&cmd, result, sizeof(result), context))
				error = "IO";
		}
	}
	p->used = 0;
	p->discard = false;
	if (error)
		snprintf(reply, size, "%" PRIu32 " ERR %s\n", id, error);
	else
		snprintf(reply, size, "%" PRIu32 " OK%s%s\n", id,
			 *result ? " " : "", result);
	return true;
}
```

## src/protocol.h
```c
/* SPDX-License-Identifier: Apache-2.0 */
#ifndef HAT_PROTOCOL_H
#define HAT_PROTOCOL_H
#include <stdbool.h>
#include <stddef.h>
#include <stdint.h>

#define HAT_LINE_MAX 128
#define HAT_FRAME_SIZE 16
enum hat_operation { HAT_HELLO, HAT_PING, HAT_SHOW, HAT_DISPLAY, HAT_FRAME };
struct hat_command {
	enum hat_operation operation;
	bool visible;
	uint8_t pixels[HAT_FRAME_SIZE];
};
typedef int (*hat_handler)(const struct hat_command *, char *, size_t, void *);
struct hat_parser {
	char line[HAT_LINE_MAX + 1];
	size_t used;
	bool discard;
};
/* Returns true when reply contains one complete response (including newline).
 */
bool hat_feed(struct hat_parser *, unsigned char, char *, size_t, hat_handler,
	      void *);
/* Discard a damaged/overflowed receive stream through its next newline. */
void hat_resync(struct hat_parser *);
/* Parse a command without its request ID. Returns NULL on success. */
const char *hat_parse_command(const char *, struct hat_command *);
#endif
```
