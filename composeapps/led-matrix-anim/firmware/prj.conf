## CMakeLists.txt
```
cmake_minimum_required(VERSION 3.20.0)
find_package(Zephyr REQUIRED HINTS $ENV{ZEPHYR_BASE})
project(led_matrix_anim)
target_sources(app PRIVATE src/main.c src/protocol.c src/animation.c)
# Identify the application sources/configuration used for this firmware.
set(fingerprint "")
foreach(input src/main.c src/protocol.c src/protocol.h src/animation.c src/animation.h prj.conf app.overlay)
  set_property(DIRECTORY APPEND PROPERTY CMAKE_CONFIGURE_DEPENDS "${input}")
  file(SHA256 "${CMAKE_CURRENT_SOURCE_DIR}/${input}" digest)
  string(APPEND fingerprint "${digest}")
endforeach()
string(SHA256 fingerprint "${fingerprint}")
string(SUBSTRING "${fingerprint}" 0 12 firmware_version)
target_compile_definitions(app PRIVATE HAT_FIRMWARE_VERSION="${firmware_version}")
```

## prj.conf
```kconfig
CONFIG_DISPLAY=y
CONFIG_COUNTER=y
CONFIG_BOOTLOADER_MCUBOOT=n
CONFIG_FLASH_LOAD_OFFSET=0
CONFIG_CONSOLE=n
CONFIG_UART_CONSOLE=n
CONFIG_SERIAL=y
CONFIG_UART_INTERRUPT_DRIVEN=y
CONFIG_ENTROPY_GENERATOR=y
CONFIG_ENTROPY_DEVICE_RANDOM_GENERATOR=y
CONFIG_MAIN_STACK_SIZE=2048
```

## app.overlay
```dts
/* A monochrome image needs only one scan per refresh. */
&led_matrix {
	grayscale-bits = <1>;
};
```

## src/animation.h
```c
/* SPDX-License-Identifier: Apache-2.0 */
#ifndef HAT_ANIMATION_H
#define HAT_ANIMATION_H
#include "protocol.h"

struct hat_player {
	struct hat_step banks[2][HAT_ANIM_MAX];
	unsigned active;
	size_t count, index, expected, uploaded;
	uint32_t remaining;
	bool uploading, running;
	int64_t deadline;
};
typedef int (*hat_draw)(const uint8_t *);
int hat_player_command(struct hat_player *, const struct hat_command *, int64_t,
		       hat_draw);
int hat_player_tick(struct hat_player *, int64_t, hat_draw);
#endif
```

## src/protocol.c
```c
/* SPDX-License-Identifier: Apache-2.0 */
#include "protocol.h"
#include <inttypes.h>
#include <stdio.h>
#include <string.h>

static int hex(unsigned char c)
{
	if (c >= '0' && c <= '9')
		return c - '0';
	if (c >= 'a' && c <= 'f')
		return c - 'a' + 10;
	if (c >= 'A' && c <= 'F')
		return c - 'A' + 10;
	return -1;
}

/* Strict unsigned decimal, with overflow and delimiter checks by the caller. */
static bool number(const char **cursor, uint32_t *value)
{
	const char *s = *cursor;
	uint32_t n = 0;
	if (*s < '0' || *s > '9')
		return false;
	while (*s >= '0' && *s <= '9') {
		unsigned d = (unsigned)(*s++ - '0');
		if (n > (UINT32_MAX - d) / 10)
			return false;
		n = n * 10 + d;
	}
	*cursor = s;
	*value = n;
	return true;
}

static bool pixels(const char *s, uint8_t *out)
{
	if (strlen(s) < HAT_FRAME_SIZE * 2)
		return false;
	for (size_t i = 0; i < HAT_FRAME_SIZE; ++i) {
		int hi = hex(s[i * 2]), lo = hex(s[i * 2 + 1]);
		if (hi < 0 || lo < 0)
			return false;
		out[i] = (uint8_t)((hi << 4) | lo);
		if ((i & 1) && (out[i] & 0xe0))
			return false;
	}
	return true;
}

const char *hat_parse_command(const char *s, struct hat_command *cmd)
{
	memset(cmd, 0, sizeof(*cmd));
	if (!strcmp(s, "HELLO"))
		cmd->operation = HAT_HELLO;
	else if (!strcmp(s, "PING"))
		cmd->operation = HAT_PING;
	else if (!strcmp(s, "SHOW HAT"))
		cmd->operation = HAT_SHOW;
	else if (!strcmp(s, "DISPLAY ON") || !strcmp(s, "DISPLAY OFF")) {
		cmd->operation = HAT_DISPLAY;
		cmd->visible = !strcmp(s, "DISPLAY ON");
	} else if (!strncmp(s, "FRAME ", 6)) {
		cmd->operation = HAT_FRAME;
		if (strlen(s + 6) != HAT_FRAME_SIZE * 2)
			return "BAD_ARGUMENT";
		if (!pixels(s + 6, cmd->pixels))
			return "BAD_ARGUMENT";
	} else if (!strcmp(s, "ANIM STOP")) {
		cmd->operation = HAT_ANIM_STOP;
	} else if (!strncmp(s, "ANIM BEGIN ", 11) ||
		   !strncmp(s, "ANIM PLAY ", 10)) {
		bool begin = s[5] == 'B';
		s += begin ? 11 : 10;
		cmd->operation = begin ? HAT_ANIM_BEGIN : HAT_ANIM_PLAY;
		if (!number(&s, &cmd->value) || *s ||
		    (begin && (!cmd->value || cmd->value > HAT_ANIM_MAX)))
			return "BAD_ARGUMENT";
	} else if (!strncmp(s, "ANIM ADD ", 9)) {
		cmd->operation = HAT_ANIM_ADD;
		s += 9;
		if (!number(&s, &cmd->value) || cmd->value < 20 ||
		    cmd->value > 60000 || *s != ' ' || strlen(s + 1) != 32 ||
		    !pixels(s + 1, cmd->pixels))
			return "BAD_ARGUMENT";
	} else {
		/* Known verbs with missing/extra arguments are distinguishable.
		 */
		static const char *const verbs[] = {"HELLO",   "PING",	"SHOW",
						    "DISPLAY", "FRAME", "ANIM"};
		for (size_t i = 0; i < sizeof(verbs) / sizeof(verbs[0]); ++i) {
			size_t n = strlen(verbs[i]);
			if (!strncmp(s, verbs[i], n) &&
			    (s[n] == 0 || s[n] == ' '))
				return "BAD_ARGUMENT";
		}
		return "UNKNOWN_COMMAND";
	}
	return NULL;
}

const char *hat_parse_client(const char *s, struct hat_command *cmd,
			     struct hat_animation *animation)
{
	if (strncmp(s, "ANIM ", 5) || !strcmp(s, "ANIM STOP"))
		return hat_parse_command(s, cmd);
	memset(cmd, 0, sizeof(*cmd));
	memset(animation, 0, sizeof(*animation));
	cmd->operation = HAT_ANIM_PLAY;
	s += 5;
	if (!number(&s, &animation->repeats) || *s != ' ')
		return "BAD_ARGUMENT";
	while (*s == ' ') {
		++s;
		if (animation->count == HAT_ANIM_MAX)
			return "BAD_ARGUMENT";
		struct hat_step *step = &animation->steps[animation->count];
		if (!number(&s, &step->duration_ms) || step->duration_ms < 20 ||
		    step->duration_ms > 60000 || *s != ':' ||
		    !pixels(s + 1, step->pixels))
			return "BAD_ARGUMENT";
		s += 33;
		++animation->count;
	}
	return *s || !animation->count ? "BAD_ARGUMENT" : NULL;
}

void hat_resync(struct hat_parser *p)
{
	p->used = 0;
	p->discard = true;
}

bool hat_feed(struct hat_parser *p, unsigned char c, char *reply, size_t size,
	      hat_handler handler, void *context)
{
	if (c != '\n') {
		if (!p->discard) {
			if (p->used == HAT_LINE_MAX ||
			    (c != '\r' && (c < 32 || c > 126)))
				hat_resync(p);
			else
				p->line[p->used++] = (char)c;
		}
		return false;
	}
	uint32_t id = 0;
	const char *error = NULL;
	char result[96] = "";
	if (p->discard)
		error = "BAD_LINE";
	else {
		if (p->used && p->line[p->used - 1] == '\r')
			--p->used;
		p->line[p->used] = 0;
		const char *s = p->line;
		if (*s < '1' || *s > '9')
			error = "BAD_ID";
		while (!error && *s >= '0' && *s <= '9') {
			unsigned digit = (unsigned)(*s++ - '0');
			if (id > (UINT32_MAX - digit) / 10)
				error = "BAD_ID";
			else
				id = id * 10 + digit;
		}
		if (error || *s != ' ') {
			id = 0;
			error = "BAD_ID";
		} else {
			struct hat_command cmd;
			error = hat_parse_command(s + 1, &cmd);
			if (!error &&
			    handler(&cmd, result, sizeof(result), context))
				error = "IO";
		}
	}
	p->used = 0;
	p->discard = false;
	if (error)
		snprintf(reply, size, "%" PRIu32 " ERR %s\n", id, error);
	else
		snprintf(reply, size, "%" PRIu32 " OK%s%s\n", id,
			 *result ? " " : "", result);
	return true;
}
```

## src/protocol.h
```c
/* SPDX-License-Identifier: Apache-2.0 */
#ifndef HAT_PROTOCOL_H
#define HAT_PROTOCOL_H
#include <stdbool.h>
#include <stddef.h>
#include <stdint.h>

#define HAT_LINE_MAX 128
#define HAT_FRAME_SIZE 16
#define HAT_ANIM_MAX 64
#define HAT_CLIENT_LINE_MAX 4096
struct hat_step {
	uint32_t duration_ms;
	uint8_t pixels[HAT_FRAME_SIZE];
};
struct hat_animation {
	uint32_t repeats;
	size_t count;
	struct hat_step steps[HAT_ANIM_MAX];
};
enum hat_operation {
	HAT_HELLO,
	HAT_PING,
	HAT_SHOW,
	HAT_DISPLAY,
	HAT_FRAME,
	HAT_ANIM_BEGIN,
	HAT_ANIM_ADD,
	HAT_ANIM_PLAY,
	HAT_ANIM_STOP
};
struct hat_command {
	enum hat_operation operation;
	bool visible;
	uint32_t value;
	uint8_t pixels[HAT_FRAME_SIZE];
};
typedef int (*hat_handler)(const struct hat_command *, char *, size_t, void *);
struct hat_parser {
	char line[HAT_LINE_MAX + 1];
	size_t used;
	bool discard;
};
/* Returns true when reply contains one complete response (including newline).
 */
bool hat_feed(struct hat_parser *, unsigned char, char *, size_t, hat_handler,
	      void *);
/* Discard a damaged/overflowed receive stream through its next newline. */
void hat_resync(struct hat_parser *);
/* Parse a command without its request ID. Returns NULL on success. */
const char *hat_parse_command(const char *, struct hat_command *);
/* Linux command syntax; staged upload commands are not exposed to clients. */
const char *hat_parse_client(const char *, struct hat_command *,
			     struct hat_animation *);
#endif
```
